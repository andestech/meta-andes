## conf/machine/include/andes-common.inc
```bitbake
#@DESCRIPTION: Machine configuration for the Andes platforms
#@MAINTAINER: Ben Zong-You Xie <ben717@andestech.com>

require conf/machine/include/riscv/tune-riscv.inc

#============================================
# Common Linux Kernel Configuration
KERNEL_CLASSES = "kernel-fitimage"
KERNEL_IMAGETYPE = "fitImage"
#============================================

#============================================
# Common Hardware Configuration
MACHINE_FEATURES = "screen keyboard ext2 ext3 serial"
SERIAL_CONSOLES = "115200;ttyS0"
MACHINE_EXTRA_RRECOMMENDS += " kernel-modules"
#============================================

#============================================
# Preferred Providers
PREFERRED_PROVIDER_virtual/kernel ?= "linux-ast540"
PREFERRED_PROVIDER_virtual/bootloader ?= "u-boot-ast540"
#============================================

#============================================
# SBI Configuration
RISCV_SBI_PLAT = "generic"
RISCV_SBI_PAYLOAD ?= "u-boot.bin"
#============================================

#============================================
# Common Image Configuration
EXTRA_IMAGEDEPENDS += "opensbi-ast540"
EXTRA_IMAGEDEPENDS += "u-boot-ast540"
WKS_FILE_DEPENDS ?= " \
    u-boot-ast540 \
    opensbi-ast540 \
    e2fsprogs-native \
    bmaptool-native \
"
IMAGE_FSTYPES += "wic.gz wic.bmap ext4"
IMAGE_BOOT_FILES ?= " \
    ${KERNEL_IMAGETYPE} \
    ${RISCV_SBI_FDT} \
    boot.scr.uimg \
    uEnv.txt \
    u-boot.itb \
    u-boot-spl.bin \
"
WKS_FILE ?= "andes-ae350-spl.wks"
#============================================
```

## conf/machine/qilai.conf
```bitbake
#@TYPE: Machine
#@NAME: qilai
#@SOC: Qilai Test Platform
#@DESCRIPTION: Machine configuration for Qilai Test Platform
#@MAINTAINER: Yu Chien Peter Lin <peterlin@andestech.com>

require conf/machine/include/riscv/tune-riscv.inc
DEFAULTTUNE = "riscv64"

#============================================
# Common Linux Kernel Configuration
KERNEL_CLASSES = "kernel"
KERNEL_IMAGETYPE = "Image"
#============================================

#============================================
# Common Hardware Configuration
MACHINE_FEATURES = "screen keyboard ext2 ext3 serial"
SERIAL_CONSOLES = "38400;ttyS0"
MACHINE_EXTRA_RRECOMMENDS += " kernel-modules"
#============================================

#============================================
# Preferred Providers
PREFERRED_PROVIDER_virtual/kernel = "linux-qilai"
PREFERRED_PROVIDER_virtual/bootloader = "u-boot-qilai"
#============================================

#============================================
# SBI Configuration
RISCV_SBI_PLAT = "generic"
RISCV_SBI_PAYLOAD ?= "u-boot.bin"
#============================================

#============================================
# Common Image Configuration
EXTRA_IMAGEDEPENDS += "opensbi-qilai"
EXTRA_IMAGEDEPENDS += "u-boot-qilai"
WKS_FILE_DEPENDS ?= " \
    u-boot-qilai \
    opensbi-qilai \
    e2fsprogs-native \
    bmaptool-native \
"
IMAGE_FSTYPES += "wic.gz wic.bmap ext4"
IMAGE_BOOT_FILES ?= " \
    ${RISCV_SBI_FDT} \
    u-boot-spl.bin \
    u-boot.itb \
    ${KERNEL_IMAGETYPE} \
    boot.scr.uimg \
    uEnv.txt \
"
WKS_FILE ?= "andes-ae350-spl.wks"
#============================================

#============================================
# In-kernel device tree name
RISCV_SBI_FDT = "qilai.dtb"
KERNEL_DEVICETREE = "andes/${RISCV_SBI_FDT}"
#============================================

#============================================
# Uboot Configuration
UBOOT_MACHINE = "qilai_spl_defconfig"
SPL_BINARY ?= "spl/u-boot-spl.bin"
# U-Boot ITB (FIT image with U-Boot S-mode, OpenSBI FW_DYNAMIC, DTB [from
# U-Boot source code tree])
UBOOT_SUFFIX ?= "itb"
## Load addresses of binary in FIT Image (see fitImage.its)
## UBOOT_ENTRYPOINT: Linux kernel load address
## UBOOT_DTB_LOADADDRESS: Device tree load address
## Qilai base address: 0x4_0000_0000
## fitImage cannot be used on Qilai because the load address will be truncated if it exceeds 32 bits.
# UBOOT_ENTRYPOINT = "0x402000000"
# UBOOT_DTB_LOADADDRESS = "0x420000000"
#============================================
```
