## conf/layer.conf
```bitbake
# We have a conf and classes directory, add to BBPATH
BBPATH .= ":${LAYERDIR}"

# We have recipes-* directories, add to BBFILES
BBFILES += "${LAYERDIR}/recipes-*/*/*.bb \
            ${LAYERDIR}/recipes-*/*/*.bbappend"

BBFILE_COLLECTIONS += "meta-andes"
BBFILE_PATTERN_meta-andes = "^${LAYERDIR}/"
BBFILE_PRIORITY_meta-andes = "6"

LAYERDEPENDS_meta-andes = "core"
LAYERSERIES_COMPAT_meta-andes = "kirkstone"
```

## conf/machine/ae350-a27l2.conf
```bitbake
#@TYPE: Machine
#@NAME: ae350-a27l2
#@SOC: AE350 A27L2
#@DESCRIPTION: Machine configuration for the AE350 Platfrom (A27L2)
#@MAINTAINER: Yu Chien Peter Lin <peterlin@andestech.com>

require conf/machine/include/andes-common.inc
DEFAULTTUNE = "riscv32"

RISCV_SBI_FDT = "a27l2_c1_d_dsp_noncoherent_ae350.dtb"
KERNEL_DEVICETREE = "andes/${RISCV_SBI_FDT}"

#============================================
# Uboot Configuration
UBOOT_MACHINE = "ae350_rv32_spl_xip_defconfig"
SPL_BINARY ?= "spl/u-boot-spl.bin"
# U-Boot ITB (FIT image with U-Boot S-mode, OpenSBI FW_DYNAMIC, DTB [from
# U-Boot source code tree])
UBOOT_SUFFIX ?= "itb"
# Load addresses of binary in FIT Image (see fitImage.its)
# UBOOT_ENTRYPOINT: Linux kernel load address
#                   RV32: 0x400000
#                   RV64: 0x200000
# UBOOT_DTB_LOADADDRESS: Device tree load address
UBOOT_ENTRYPOINT = "0x400000"
UBOOT_DTB_LOADADDRESS = "0x20000000"
#============================================
```

## conf/machine/ae350-a45mp.conf
```bitbake
#@TYPE: Machine
#@NAME: ae350-a45mp
#@SOC: AE350 A45MP
#@DESCRIPTION: Machine configuration for the AE350 Platfrom (A45MP)
#@MAINTAINER: Yu Chien Peter Lin <peterlin@andestech.com>

require conf/machine/include/andes-common.inc
DEFAULTTUNE = "riscv32"

RISCV_SBI_FDT = "a45mp_c4_d_dsp_ae350.dtb"
KERNEL_DEVICETREE = "andes/${RISCV_SBI_FDT}"

#============================================
# Uboot Configuration
UBOOT_MACHINE = "ae350_rv32_spl_xip_defconfig"
SPL_BINARY ?= "spl/u-boot-spl.bin"
# U-Boot ITB (FIT image with U-Boot S-mode, OpenSBI FW_DYNAMIC, DTB [from
# U-Boot source code tree])
UBOOT_SUFFIX ?= "itb"
# Load addresses of binary in FIT Image (see fitImage.its)
# UBOOT_ENTRYPOINT: Linux kernel load address
#                   RV32: 0x400000
#                   RV64: 0x200000
# UBOOT_DTB_LOADADDRESS: Device tree load address
UBOOT_ENTRYPOINT = "0x400000"
UBOOT_DTB_LOADADDRESS = "0x20000000"
#============================================
```

## conf/machine/ae350-ax45mp.conf
```bitbake
#@TYPE: Machine
#@NAME: ae350-ax45mp
#@SOC: AE350 AX45MP
#@DESCRIPTION: Machine configuration for the AE350 Platfrom (AX45MP)
#@MAINTAINER: Yu Chien Peter Lin <peterlin@andestech.com>

require conf/machine/include/riscv/tune-riscv.inc

MACHINE_FEATURES = "screen keyboard ext2 ext3 serial"

KERNEL_CLASSES = "kernel-fitimage"
KERNEL_IMAGETYPE = "fitImage"
KERNEL_DEVICETREE ?= "andes/ae350_c4_64_d.dtb"

PREFERRED_PROVIDER_virtual/kernel ?= "linux-ast510"
PREFERRED_PROVIDER_virtual/bootloader ?= "u-boot-ast510"

EXTRA_IMAGEDEPENDS += "opensbi-ast510"
RISCV_SBI_PLAT = "andes/ae350"
RISCV_SBI_FDT ?= "ae350_c4_64_d.dtb"

SERIAL_CONSOLES = "38400;ttyS0"

MACHINE_EXTRA_RRECOMMENDS += " kernel-modules"

IMAGE_FSTYPES ?= "wic.gz wic.bmap ext4"


EXTRA_IMAGEDEPENDS += "u-boot-ast510"
UBOOT_MACHINE = "ae350_rv64_spl_xip_defconfig"

# U-Boot SPL
SPL_BINARY ?= "spl/u-boot-spl.bin"

# U-Boot ITB (FIT image with U-Boot S-mode, OpenSBI FW_DYNAMIC, DTB [from
# U-Boot source code tree])
UBOOT_SUFFIX ?= "itb"

UBOOT_ENTRYPOINT = "0x600000"
UBOOT_DTB_LOADADDRESS = "0x20000000"

## wic default support
WKS_FILE_DEPENDS ?= " \
    u-boot-ast510 \
    opensbi-ast510 \
    e2fsprogs-native \
    bmap-tools-native \
"

IMAGE_BOOT_FILES ?= " \
    ${KERNEL_IMAGETYPE} \
    ${RISCV_SBI_FDT} \
    boot.scr.uimg \
    uEnv.txt \
    u-boot.itb \
    u-boot-spl.bin \
"

WKS_FILE ?= "ae350-ax45mp-spl.wks"
```

## conf/machine/ae350-ax65.conf
```bitbake
#@TYPE: Machine
#@NAME: ae350-ax65
#@SOC: AE350 AX65
#@DESCRIPTION: Machine configuration for the AE350 Platfrom (AX65)
#@MAINTAINER: Yu Chien Peter Lin <peterlin@andestech.com>

require conf/machine/include/andes-common.inc
DEFAULTTUNE = "riscv64"

RISCV_SBI_FDT = "ax65mp_c1_d_dsp_ae350.dtb"
KERNEL_DEVICETREE = "andes/${RISCV_SBI_FDT}"

#============================================
# Uboot Configuration
UBOOT_MACHINE = "ae350_rv64_spl_xip_defconfig"
SPL_BINARY ?= "spl/u-boot-spl.bin"
# U-Boot ITB (FIT image with U-Boot S-mode, OpenSBI FW_DYNAMIC, DTB [from
# U-Boot source code tree])
UBOOT_SUFFIX ?= "itb"
# Load addresses of binary in FIT Image (see fitImage.its)
# UBOOT_ENTRYPOINT: Linux kernel load address
#                   RV32: 0x400000
#                   RV64: 0x200000
# UBOOT_DTB_LOADADDRESS: Device tree load address
UBOOT_ENTRYPOINT = "0x200000"
UBOOT_DTB_LOADADDRESS = "0x20000000"
#============================================
```

## conf/machine/include/riscv/tune-andes.inc
```bitbake
require conf/machine/include/riscv/tune-riscv.inc

TUNEVALID[andes-ax45mp-series] = "AndesCore AX45MP Series"

AVAILTUNES += " andes-ax45mp-series"

# AndesCore AX45MP Series
TUNE_FEATURES:tune-andes-ax45mp-series = "${TUNE_FEATURES:tune-riscv64} andes-ax45mp-series"
TUNE_ARCH:tune-andes-ax45mp-series = "riscv64"
TUNE_PKGARCH:tune-andes-ax45mp-series = "riscv64"
PACKAGE_EXTRA_ARCHS:tune-andes-ax45mp-series = "riscv64"

TUNE_CCARGS:append = "${@bb.utils.contains('TUNE_FEATURES', 'andes-ax45mp-series', ' -mtune=andes-ax45mp-series', ' ', d)}"
```

## recipes-kernel/linux/files/ae350_rv32_smp_defconfig
```kconfig
CONFIG_DEFAULT_HOSTNAME="andes-test"
CONFIG_SYSVIPC=y
CONFIG_POSIX_MQUEUE=y
CONFIG_NO_HZ_IDLE=y
CONFIG_HIGH_RES_TIMERS=y
CONFIG_BPF_SYSCALL=y
CONFIG_PREEMPT=y
CONFIG_IKCONFIG=y
CONFIG_IKCONFIG_PROC=y
CONFIG_CGROUPS=y
CONFIG_CGROUP_SCHED=y
CONFIG_CFS_BANDWIDTH=y
CONFIG_CGROUP_BPF=y
CONFIG_NAMESPACES=y
CONFIG_USER_NS=y
CONFIG_CHECKPOINT_RESTORE=y
CONFIG_BLK_DEV_INITRD=y
CONFIG_INITRAMFS_SOURCE="rootfs-lite initramfs.txt.lite"
# CONFIG_RD_BZIP2 is not set
# CONFIG_RD_LZMA is not set
# CONFIG_RD_XZ is not set
# CONFIG_RD_LZO is not set
# CONFIG_RD_LZ4 is not set
# CONFIG_RD_ZSTD is not set
# CONFIG_INITRAMFS_PRESERVE_MTIME is not set
# CONFIG_SYSFS_SYSCALL is not set
CONFIG_EMBEDDED=y
CONFIG_PROFILING=y
CONFIG_PLAT_AE350=y
CONFIG_SOC_VIRT=y
CONFIG_NONPORTABLE=y
CONFIG_ARCH_RV32I=y
CONFIG_CMODEL_MEDANY=y
CONFIG_SMP=y
CONFIG_HZ_100=y
CONFIG_RISCV_SBI_V01=y
CONFIG_CPU_IDLE=y
CONFIG_CPU_FREQ=y
CONFIG_JUMP_LABEL=y
# CONFIG_STRICT_KERNEL_RWX is not set
CONFIG_MODULES=y
CONFIG_MODULE_UNLOAD=y
CONFIG_NET=y
CONFIG_PACKET=y
CONFIG_UNIX=y
CONFIG_NET_KEY=y
CONFIG_INET=y
# CONFIG_INET_DIAG is not set
# CONFIG_WIRELESS is not set
# CONFIG_ETHTOOL_NETLINK is not set
CONFIG_DEVTMPFS=y
CONFIG_DEVTMPFS_MOUNT=y
CONFIG_MTD=y
CONFIG_MTD_SPI_NOR=y
CONFIG_BLK_DEV_LOOP=y
CONFIG_VIRTIO_BLK=y
CONFIG_SCSI=y
CONFIG_BLK_DEV_SD=y
CONFIG_BLK_DEV_SR=y
CONFIG_SCSI_VIRTIO=y
CONFIG_NETDEVICES=y
# CONFIG_NET_VENDOR_ALACRITECH is not set
# CONFIG_NET_VENDOR_AMAZON is not set
# CONFIG_NET_VENDOR_AQUANTIA is not set
# CONFIG_NET_VENDOR_ARC is not set
# CONFIG_NET_VENDOR_ASIX is not set
# CONFIG_NET_VENDOR_BROADCOM is not set
# CONFIG_NET_VENDOR_CADENCE is not set
# CONFIG_NET_VENDOR_CAVIUM is not set
# CONFIG_NET_VENDOR_CORTINA is not set
# CONFIG_NET_VENDOR_DAVICOM is not set
# CONFIG_NET_VENDOR_ENGLEDER is not set
# CONFIG_NET_VENDOR_EZCHIP is not set
CONFIG_FTMAC100=y
# CONFIG_NET_VENDOR_FUNGIBLE is not set
# CONFIG_NET_VENDOR_GOOGLE is not set
# CONFIG_NET_VENDOR_HUAWEI is not set
# CONFIG_NET_VENDOR_INTEL is not set
# CONFIG_NET_VENDOR_WANGXUN is not set
# CONFIG_NET_VENDOR_LITEX is not set
# CONFIG_NET_VENDOR_MELLANOX is not set
# CONFIG_NET_VENDOR_MICREL is not set
# CONFIG_NET_VENDOR_MICROCHIP is not set
# CONFIG_NET_VENDOR_MICROSEMI is not set
# CONFIG_NET_VENDOR_MICROSOFT is not set
# CONFIG_NET_VENDOR_NI is not set
# CONFIG_NET_VENDOR_NATSEMI is not set
# CONFIG_NET_VENDOR_NETRONOME is not set
# CONFIG_NET_VENDOR_PENSANDO is not set
# CONFIG_NET_VENDOR_QUALCOMM is not set
# CONFIG_NET_VENDOR_RENESAS is not set
# CONFIG_NET_VENDOR_ROCKER is not set
# CONFIG_NET_VENDOR_SAMSUNG is not set
# CONFIG_NET_VENDOR_SEEQ is not set
# CONFIG_NET_VENDOR_SOLARFLARE is not set
# CONFIG_NET_VENDOR_SOCIONEXT is not set
# CONFIG_NET_VENDOR_STMICRO is not set
# CONFIG_NET_VENDOR_SYNOPSYS is not set
# CONFIG_NET_VENDOR_VERTEXCOM is not set
# CONFIG_NET_VENDOR_VIA is not set
# CONFIG_NET_VENDOR_WIZNET is not set
# CONFIG_NET_VENDOR_XILINX is not set
# CONFIG_WLAN is not set
CONFIG_INPUT_MOUSEDEV=y
CONFIG_SERIAL_8250=y
CONFIG_SERIAL_8250_CONSOLE=y
CONFIG_SERIAL_OF_PLATFORM=y
CONFIG_SERIAL_EARLYCON_RISCV_SBI=y
CONFIG_VIRTIO_CONSOLE=y
CONFIG_HW_RANDOM=y
CONFIG_HW_RANDOM_VIRTIO=y
CONFIG_I2C=y
CONFIG_I2C_CHARDEV=y
CONFIG_I2C_ATCIIC100=y
CONFIG_ATCIIC_IRQ=y
CONFIG_SPI=y
CONFIG_SPI_ATCSPI200=y
CONFIG_GPIOLIB=y
CONFIG_DEBUG_GPIO=y
CONFIG_GPIO_SYSFS=y
CONFIG_GPIO_ATCGPIO100=y
CONFIG_GPIO_SIFIVE=y
CONFIG_POWER_SUPPLY=y
# CONFIG_HWMON is not set
CONFIG_WATCHDOG=y
CONFIG_WATCHDOG_CORE=y
CONFIG_ATCWDT200_WATCHDOG=y
CONFIG_FB=y
CONFIG_FB_FTLCDC100=y
CONFIG_FRAMEBUFFER_CONSOLE=y
CONFIG_SOUND=y
CONFIG_SND=y
CONFIG_SND_OSSEMUL=y
CONFIG_SND_PCM_OSS=y
CONFIG_SND_FTSSP010=y
# CONFIG_USB_SUPPORT is not set
CONFIG_MMC=y
CONFIG_MMC_SDHCI=y
CONFIG_MMC_SDHCI_PLTFM=y
CONFIG_MMC_SDHCI_CADENCE=y
CONFIG_MMC_FTSDC=y
CONFIG_MMC_FTSDCG=y
CONFIG_RTC_CLASS=y
CONFIG_RTC_DRV_ATCRTC100=y
CONFIG_DMADEVICES=y
CONFIG_ATCDMAC300G=y
CONFIG_SYNC_FILE=y
CONFIG_VIRTIO_BALLOON=y
CONFIG_VIRTIO_INPUT=y
CONFIG_VIRTIO_MMIO=y
# CONFIG_VHOST_MENU is not set
# CONFIG_IOMMU_SUPPORT is not set
CONFIG_ANDES_CACHE=y
CONFIG_ANDES_DMA_NONCOHERENT=y
CONFIG_ANDES_PPMA=y
CONFIG_ATCDMAC300=y
CONFIG_ANDES_ATCSMU=y
CONFIG_PWM=y
CONFIG_PWM_ATCPIT100=y
CONFIG_EXT2_FS=y
CONFIG_EXT4_FS=y
CONFIG_EXT4_FS_POSIX_ACL=y
CONFIG_EXT4_FS_SECURITY=y
CONFIG_EXPORTFS_BLOCK_OPS=y
CONFIG_FANOTIFY=y
CONFIG_MSDOS_FS=y
CONFIG_VFAT_FS=y
CONFIG_TMPFS=y
CONFIG_TMPFS_POSIX_ACL=y
CONFIG_HUGETLBFS=y
CONFIG_CONFIGFS_FS=y
# CONFIG_EFIVAR_FS is not set
# CONFIG_MISC_FILESYSTEMS is not set
CONFIG_NFS_FS=y
CONFIG_NFS_V3_ACL=y
CONFIG_NFS_V4=y
CONFIG_NFS_V4_1=y
CONFIG_NFS_V4_2=y
CONFIG_NFS_USE_LEGACY_DNS=y
# CONFIG_NFS_DISABLE_UDP_SUPPORT is not set
CONFIG_NLS_CODEPAGE_437=y
CONFIG_NLS_ISO8859_1=y
CONFIG_CRYPTO_DEV_VIRTIO=y
CONFIG_CRC_ITU_T=y
CONFIG_CRC7=y
CONFIG_XZ_DEC=y
CONFIG_PRINTK_TIME=y
CONFIG_DEBUG_INFO_DWARF4=y
CONFIG_GDB_SCRIPTS=y
CONFIG_FRAME_WARN=2048
CONFIG_READABLE_ASM=y
CONFIG_DEBUG_FS=y
CONFIG_DEBUG_PAGEALLOC=y
CONFIG_PTDUMP_DEBUGFS=y
CONFIG_SCHED_STACK_END_CHECK=y
CONFIG_DEBUG_VM=y
CONFIG_DEBUG_VM_PGFLAGS=y
CONFIG_DEBUG_MEMORY_INIT=y
CONFIG_SOFTLOCKUP_DETECTOR=y
CONFIG_WQ_WATCHDOG=y
CONFIG_DEBUG_TIMEKEEPING=y
# CONFIG_DEBUG_PREEMPT is not set
CONFIG_DEBUG_RT_MUTEXES=y
CONFIG_DEBUG_SPINLOCK=y
CONFIG_DEBUG_MUTEXES=y
CONFIG_DEBUG_RWSEMS=y
CONFIG_DEBUG_LIST=y
CONFIG_DEBUG_PLIST=y
CONFIG_DEBUG_SG=y
# CONFIG_RCU_TRACE is not set
CONFIG_RCU_EQS_DEBUG=y
# CONFIG_FTRACE is not set
# CONFIG_RUNTIME_TESTING_MENU is not set
CONFIG_MEMTEST=y
```
